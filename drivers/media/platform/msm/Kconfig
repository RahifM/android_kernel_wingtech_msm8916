## drivers/media/platform/msm/Kconfig
```kconfig
source "drivers/media/platform/msm/vidc/Kconfig"

#
# MSM camera configuration
#

comment "QTI MSM Camera And Video & AIS"

menuconfig MSM_CAMERA
	bool "QTI MSM camera and video capture support"
	depends on ARCH_MSM && VIDEO_V4L2 && I2C
	---help---
	  Say Y here to enable selecting the video adapters for
	  QTI msm camera and video capture drivers. enabling this
	  adds support for the camera driver stack including sensor, isp
	  and postprocessing drivers for legacy chipsets.

config MSM_CAMERA_DEBUG
	bool "QTI MSM camera debugging with printk"
	depends on MSM_CAMERA
	default n
	---help---
	  Enable printk() debug for msm camera

config MSM_CAMERA_AUTOMOTIVE
	bool "QTI MSM camera for automotive support"
	depends on MSM_CAMERA
	default n
	---help---
	  Enables support for automotive targets

menuconfig MSMB_CAMERA
	bool "QTI MSM camera and video capture 2.0 support"
	depends on ARCH_MSM && VIDEO_V4L2 && I2C
	---help---
	  Say Y here to enable selecting the video adapters for
	  QTI msm camera and video capture 2.0, enabling this
	  adds support for the camera driver stack including sensor, isp
	  and postprocessing drivers.

config MSMB_CAMERA_DEBUG
	bool "QTI MSM camera 2.0 debugging with printk"
	depends on MSMB_CAMERA
	---help---
	  Enable printk() debug for msm camera 2.0

menuconfig WT88047_CAMERA
	bool "Wingtech WT88047 variant of the camera stack"
	depends on ARCH_MSM && VIDEO_V4L2 && I2C && MSMB_CAMERA && MACH_WT88047
	default n
	---help---
          Enable the old Wingtech WT88047 camera code

if MSMB_CAMERA
if WT88047_CAMERA
source "drivers/media/platform/msm/camera_wt88047_v2/Kconfig"
endif
if !WT88047_CAMERA
source "drivers/media/platform/msm/camera_v2/Kconfig"
endif
endif # MSMB_CAMERA

source "drivers/media/platform/msm/ais/Kconfig"
source "drivers/media/platform/msm/dvb/Kconfig"
source "drivers/media/platform/msm/broadcast/Kconfig"
source "drivers/media/platform/msm/sde/Kconfig"
```
